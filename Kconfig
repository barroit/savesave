## Kconfig
```kconfig
# SPDX-License-Identifier: GPL-3.0-only
mainmenu "Savesave/$(BUILD)-$(ARCH) $(SAVESAVE_VERSION) Configuration"

menu "Debugging"

config ENABLE_DEBUGGING
	bool "enable debugging"
	imply USE_ASAN
	imply USE_UBSAN
	imply NO_LONGRUNNING_DAEMON
	imply SUPPRESS_ANNOTATED_LEAKS
	imply USE_POISON
	default y if "$(UNIX)"

menu "Sanitizers"

config USE_ASAN
	bool "address - memory-related bugs"
	select NO_REPORT_HOOK if "$(WIN32)"
	select NO_WIN_GUI if "$(WIN32)"

config USE_UBSAN
	bool "undefined - various kinds of undefined behavior"
	select NO_WIN_GUI if "$(WIN32)"

if "$(UNIX)"

config USE_TSAN
	bool "thread - data races and thread-related bugs"

config USE_MSAN
	bool "memory - uninitialized memory reads"
	depends on CC_IS_CLANG

endif # "$(UNIX)"

endmenu # "Sanitizers"

config NO_LONGRUNNING_DAEMON
	bool "disable daemonized longrunning"
	select NO_WIN_GUI if "$(WIN32)"

config SUPPRESS_ANNOTATED_LEAKS
	bool "suppress annotated leaks"

config USE_POISON
	bool "use poison value"

if "$(WIN32)"
config DEBUG_INTLDLL
	bool "debug libintl"

config MAX_DUMP_STACK
	int "max dump stack (up to USHRT_MAX)"
	default 64

config NO_REPORT_HOOK
	bool "disable crt report hook"
endif # "$(WIN32)"

endmenu # "Debugging"

menu "Compiler"

choice
	prompt "CC"

config CC_IS_GCC
	bool "gcc"
	depends on "$(UNIX)"

config CC_IS_CLANG
	bool "clang"

endchoice

config CC_NAME
	string
	default "gcc" if CC_IS_GCC
	default "clang" if CC_IS_CLANG

choice
	prompt "Debug level"
	default COMPILER_DEBUG_3

config COMPILER_DEBUG_0
	bool "0 - produces no debug information at all"

config COMPILER_DEBUG_1
	bool "1 - produces minimal information"

config COMPILER_DEBUG_2
	bool "2 - produces more information"

config COMPILER_DEBUG_3
	bool "3 - includes as much information as possible"

endchoice

choice
	prompt "Optimizations"
	default COMPILER_OPTIMIZE_0

config COMPILER_OPTIMIZE_0
	bool "0 - reduce compilation time"

config COMPILER_OPTIMIZE_1
	bool "1 - optimize a little"

config COMPILER_OPTIMIZE_2
	bool "2 - optimize even more"

config COMPILER_OPTIMIZE_3
	bool "3 - optimize yet more"

endchoice

config COMPILER_WARNING_ALL
	bool "use -Wall"
	default y

config COMPILER_WARNING_EXTRA
	bool "use -Wextra"

endmenu # "Compiler"

menu "Features"

config NO_WIN_GUI
	bool "build console version of savesave"
	depends on "$(WIN32)"

config ARCHIVE_EXTENTION
	string "file extension for archive file (no dot)"
	default "ss"

config TMPFILE_EXTENTION
	string "file extension for temporary directory (no dot)"
	default "tmp"

config LINEWRAP_THRESHOLD
	int "character threshold for line wrap"
	default 80

config DISALBE_GETTEXT
	bool "disable i18n features"

if !DISALBE_GETTEXT
config TARGET_LOCALE
	string "user locale for gettext"

config LINK_LIBZSTD_STATIC
	bool "link against libzstd static library"
	depends on "$(UNIX)"
endif # DISALBE_GETTEXT

config AIO_COPY_THRESHOLD
	int "maximum period before switching to AIO copy (in seconds)"
	default 3600

config MIN_KVERSION
	int "minimum required version of kernel"
	default 5 if "$(LINUX)"
	default 7 if "$(WIN32)"
	default 0

config MIN_KPATCHLEVEL
	int "minimum required patch level of kernel"
	default 19 if "$(LINUX)"
	default 0

endmenu # "Features"
```
